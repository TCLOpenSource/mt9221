## drivers/mstar2/drv/utopia2k_builtin/Kconfig
```kconfig
config MSTAR_UTOPIA2K_BUILTIN

bool "UTOPIA2K_BUILTIN"
default n
help
    MStar Utopia2K related driver
```

## drivers/mstar2/drv/utopia2k_str/Kconfig
```kconfig
config MSTAR_UTOPIA2K_STR

tristate "UTOPIA2K_STR"
depends on MP_MSTAR_STR_BASE
default n
select APM_EMULATION
help
    MStar Utopia2K STR driver function
```

## drivers/mstar2/drv/voice/Kconfig
```kconfig
menuconfig MSTAR_VOICE
	tristate "Voice driver"
	select SOUND
	select SND
	select SND_SOC
	select SND_PCM
#	select SND_HWDEP
	help
	  Say Y or M if you want to add support for
	  the cleveland Voice driver.

if MSTAR_VOICE
	  
config MSTAR_VOICE_DRIVER_DRV
  tristate "cm4 voice support - DRV layer"
  default y
  help
		MStar ALSA Voice Driver - DRV Layer.

config MSTAR_VOICE_DRIVER_HAL
  tristate "cm4 voice support - HAL layer"
    default y
  depends on MSTAR_VOICE_DRIVER_DRV
  help
	  MStar ALSA Voice Driver - DRV Layer.

config MSTAR_VOICE_MMAP_BUF
  bool "MMAP buffer allocation"
  default n
  help
		Enable MMAP buffer support.
endif #MSTAR_VOICE
```

## drivers/mstar2/drv/wifi_ctl/Kconfig
```kconfig
config MTK_WIFI_CONTROL

tristate "Enable MTK WIFI / BT reset control"

help
    Enable MTK WIFI / BT reset control
default n
```

## drivers/mstar2/drv/xc/Kconfig
```kconfig
config MSTAR_XC
tristate "MSTAR_XC"
default n
help
    enable MStar smart card driver.


config MSTAR_FRC_SOFTWARE_TOGGLE
tristate "FRC software interrupt toggle"
default n
help
    enable MStar FRC software interrupt toggle.


config MSTAR_XC_HDR_SUPPORT
bool "XC HDR Support"
default n
help
    enable MStar XC HDR Support

config MSTAR_XC_DoVi_HDR_SUPPORT
bool "XC Dolby HDR Support"
default n
help
    enable MStar XC Dolby HDR Support

config MSTAR_DISABLE_DV
bool "Disable Dolby Vision"
default n
help
    disable dolby vision

config MSTAR_XC_SET_PQBINPATH
bool "XC SET PQBINPATH"
default n
help
    enable MStar XC SET PQBINPATH

config MSTAR_XC_SUPPORT_HSY
bool "XC SUPPORT HSY"
default n
help
    enable MSTAR_XC_SUPPORT_HSY
```

## drivers/mtk_misc/Kconfig
```kconfig
config MTK_FUSION
	tristate "Fusion"
	---help---
	  Fusion is the IPC API used by DirectFB and FusionSound.
config NATIVE_CB2
	bool "callback mechanism in native"     
      
config HAS_WAKELOCK
	bool
	default y

config HAS_EARLYSUSPEND
	bool
	default n

config WAKELOCK
	bool "Android's method of preventing suspend"
	default y
	---help---
	  This allows applications to prevent the CPU from suspending while
	  they need it.

	  Say Y if you are running an android userspace.

config EARLYSUSPEND
	bool "Early suspend"
	depends on WAKELOCK
	default n
	select HAS_EARLYSUSPEND
	---help---
	  Call early suspend handlers when the user requested sleep state
	  changes.


config FB_EARLYSUSPEND
	bool "FB Early suspend"
	depends on EARLYSUSPEND
	default n
	select HAS_EARLYSUSPEND
	---help---
	  Call early suspend handlers when the user requested sleep state
	  changes.

config MTK_WIFI
	tristate "MTK_WIFI"
	select WEXT_PRIV
	select WIRELESS_EXT
	select CFG80211_INTERNAL_REGDB
	---help---
	  You'd better turn on it when you want to use iwpriv
```
