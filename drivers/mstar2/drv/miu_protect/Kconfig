## drivers/mstar2/drv/miu_protect/Kconfig
```kconfig
#ifdef CONFIG_MP_MMA_ENABLE
config MSTAR_MIUPROTECT
bool  "MIU PROTECT"
depends on CMA
 
help
    MStar CMA POOL driver function
#endif

    
```

## drivers/mstar2/drv/mma/Kconfig
```kconfig
config MMA_MPU_PATCH
	bool  "MMA MPU PATCH"
	depends on MP_MMA_ENABLE
	default n
	help
		mma mpu patch for mmap not ready
config MP_MMA_CMA_ENABLE
        bool  "MP MMA CMA ENABLE"
        depends on MP_MMA_ENABLE
        default n
        help
                mp mma cma enable
config MP_IOMMU_DISCRETE_CMA
        bool  "MP IOMMU DISCRETE CMA ENABLE"
        depends on MP_MMA_ENABLE
        default n
        help
                mp iommu discrete cma enable
```

## drivers/mstar2/drv/monitor/Kconfig
```kconfig
config MSTAR_PROCESS_MONITOR
	bool "Process Monitor Module"
	default n
	help
		Monitor user process dynamicly
```

## drivers/mstar2/drv/mspi/Kconfig
```kconfig
config MSTAR_MSPI
tristate "MSPI"
default n
select SPI
help
Mstar MSPI master driver

if MSTAR_MSPI
config LOOPBACK_TEST
   bool "mspi-loopback-test"
    default n
endif
```

## drivers/mstar2/drv/mzc/Kconfig
```kconfig
config MP_MZCCMDQ_HW
    bool "HW MZC + CMDQ"
    default n
    select MP_MZCCMDQ_HYBRID_HW
    help
        HW MZC DRIVER
config MP_MZCCMDQ_HW_INTERRUPT_MODE
    bool "HW MZC + Interrupt mode"
    default n
    help
        HW MZC interrupt mode
config MP_ZRAM_PERFORMANCE
    bool "zram performance"
    default n
    help
        zram performance
config MP_MZCCMDQ_HYBRID_HW
    bool "MZC + LZO HYBRID MODE"
    depends on MP_MZCCMDQ_HW
    default n
    help
        zram hybrid compression
config MP_MZCCMDQ_HW_SPLIT
    bool "mzc 1.5"
    depends on MP_MZCCMDQ_HW
    default n
```

## drivers/mstar2/drv/nand/Kconfig
```kconfig
config MSTAR_NAND
  select MTD
  select MTD_BLKDEVS
  select MTD_OOPS

  select MTD_NAND_PLATFORM
  select MTD_CMDLINE_PARTS
  select MTD_UBI

  select MTD_NAND
  
  tristate "NAND"
  default n

help
    Enable MSTAR FCIE NAND driver

config MTD_SLC_WRITE
  bool "MTD Write/Read SLC partition"
  depends on MSTAR_NAND	
  default n
  help   
    Support Write/Read SLC Partition
    
config MSTAR_NAND_CHK_VERSION
  bool "MStar NAND driver - check version"
  depends on MSTAR_NAND
  help
    MStar NAND driver - check version.
    
config MSTAR_UNFD_BLK
	bool "mstar unfd ftl block device interface"
    depends on MSTAR_NAND
	default n
	help
		Enable Mstar unfd_FTL block device interface

config MSTAR_FTL
  tristate "Mstar FTL on nand driver"
  depends on MSTAR_NAND
  default n
  help
    Enable Mstar MLC FTL

config MSTAR_RESERVED_END_OF_NAND
	bool "enable reserved bytes from end of nand"
	depends on MSTAR_NAND
	default n
	help
		Enable reserved bytes from end of nand flash for security data

config MSTAR_RESERVED_NAND_BYTE
    int "reserved bytes from end of nand"
	depends on MSTAR_RESERVED_END_OF_NAND
	default 0
	range 0 2147483647
	help
		Reserved bytes from end of nand flash for security data
```

## drivers/mstar2/drv/noe/Kconfig
```kconfig
if (MSTAR_K7U)
menu "MStar Network Offload Engine"

source "drivers/mstar2/drv/noe/eth/Kconfig"

if NETFILTER
config NOE_NAT_HW
    bool "HW NAT support (Module Mode Only)"
    depends on NOE
source "drivers/mstar2/drv/noe/nat/hw_nat/Kconfig"
endif   # if NETFILTER
endmenu #"MStar Network Offload Engine"
endif   # (MSTAR_K7U)
```

## drivers/mstar2/drv/noe/eth/Kconfig
```kconfig
config NOE
    bool "Ethernet GMAC"
    ---help---
      This driver support gigabit ethernet family of adapters.

if NOE

config GPHY_INIT_IN_SBOOT
bool "Init GPHY in sboot"
default n
depends on MSTAR_K7U
help
    Move GPHY init to sboot for saving auto negotiation time

config GMAC_GPHY_TO_EPHY
bool "GPHY to EPHY mode"
default n
depends on MSTAR_K7U
help
    Change GPHY to EPHY mode with speed support 10/100

choice
    prompt "GMAC1 is connected to"
    depends on NOE
    default GE1_GMII_AN_INTPHY

#config  GE1_RGMII_ONE_EPHY
#   bool "RGMII + 1 port EPHY"
#    depends on !NOE_GE1_SGMII

#config  GE1_RGMII_FORCE_1000
#   bool "RGMII_FORCE_1000 (GigaSW, CPU)"
#    depends on !NOE_GE1_SGMII

#config  GE1_RGMII_AN
#   bool "RGMII_AN (GigaPhy)"
#    depends on !NOE_GE1_SGMII

#config  GE1_SGMII_AN
#   bool "SGMII_AN (GigaPhy)"
#    depends on NOE_GE1_SGMII

#config  GE1_RGMII_NONE
#   bool "NONE (NO CONNECT)"

config  GE1_GMII_AN_INTPHY
    bool "GMII_AN (Internal GigaPhy)"

config  GE1_GMII_AN_EXTPHY
    bool "GMII_AN (External GigaPhy)"

endchoice

config  MAC_TO_GIGAPHY_MODE_ADDR
    hex "GE1 Phy Address"
    default 0x1 if GE1_GMII_AN_INTPHY
    default 0x2 if GE1_GMII_AN_EXTPHY
    depends on GE1_MII_AN || GE1_RGMII_AN || GE1_SGMII_AN || GE1_GMII_AN_INTPHY || GE1_GMII_AN_EXTPHY


config  MAC_TO_GIGAPHY_MODE_ADDR
    hex "Port5 Phy Address"
    default 0x5
    depends on P5_MAC_TO_PHY_MODE

config NOE_GMAC2
    bool "GMAC2 Support"
    depends on NOE
    default y

config NOE_GMAC2_IN_PM_MODE
    bool "Power Saving Support on GMAC2"
    depends on (NOE_GMAC2 && (GE1_GMII_AN_INTPHY || GE1_RGMII_NONE))
    default n if NOE_GMAC2

choice
    prompt "GMAC2 is connected to"
    depends on NOE_GMAC2
    default GE2_GMII_AN_EXTPHY

#config  GE2_RGMII_FORCE_1000
#   bool "RGMII_FORCE_1000 (GigaSW, CPU)"
#    depends on NOE_GMAC2 && !NOE_GE2_SGMII

#config  GE2_RGMII_AN
#   bool "RGMII_AN (External GigaPhy)"
#    depends on NOE_GMAC2 && !NOE_GE2_SGMII

#config  GE2_INTERNAL_GPHY
#   bool "RGMII_AN (Internal GigaPhy)"
#    depends on NOE_GMAC2
#   select LAN_WAN_SUPPORT

#config  GE2_SGMII_AN
#   bool "SGMII_AN (GigaPhy)"
#    depends on NOE_GE2_SGMII

#config  GE2_SGMII_FORCE_2500
#   bool "SGMII_FORCE_2500 (GigaSW)"
#    depends on NOE_GE2_SGMII


config GE2_GMII_AN_EXTPHY
    bool "GMII (External GigaPhy)"
    depends on NOE_GMAC2

endchoice


config  MAC_TO_GIGAPHY_MODE_ADDR2
    hex
    default 0 if GE_RGMII_INTERNAL_P0_AN
    default 4 if GE_RGMII_INTERNAL_P4_AN
    default 1 if GE2_GMII_AN_EXTPHY
    depends on GE_RGMII_INTERNAL_P0_AN || GE_RGMII_INTERNAL_P4_AN

config  MAC_TO_GIGAPHY_MODE_ADDR2
    hex "GE2 Phy Address"
    default 0x1 if GE2_GMII_AN_EXTPHY
    default 0x2 if NOE_GMAC2_IN_PM_MODE
    depends on GE2_MII_AN || GE2_RGMII_AN || GE2_SGMII_AN || GE2_GMII_AN_EXTPHY


#choice
#    prompt "Network BottomHalves"
#    depends on NOE
#    default NOE_NETWORK_TASKLET_BH

config NOE_NETWORK_TASKLET_BH
#    bool "Tasklet"
    bool
    default n

config NOE_NETWORK_WORKQUEUE_BH
#    bool "Work Queue"
    bool
    default n

config NOE_NAPI
#    bool "NAPI"
    bool
    default y
#endchoice

#config NOE_SPECIAL_TAG
#   bool "Special Tag (0x810x)"
#   depends on NOE

config NOE_CHECKSUM_OFFLOAD
    bool
    default y
    depends on NOE

#config NOE_HW_IOCOHERENT
#    bool
#   default n
#   depends on NOE

config NOE_HW_LRO
#   bool "HW LRO"
    bool
    default y
    depends on NOE

config NOE_HW_VLAN_TX
    bool
    default y
    depends on NOE
    ---help---
      Please disable HW_VLAN_TX if you need double vlan

config NOE_HW_VLAN_RX
    bool
    default n
    depends on NOE
    ---help---
      Please disable HW_VLAN_RX if you need double vlan

config NOE_TSO
    bool
    default y
    depends on NOE_HW_VLAN_TX

config NOE_ETHTOOL
    bool
    default y if MII
    depends on NOE

config NOE_QDMA
    #bool "Choose QDMA istead PDMA"
    bool
    default y
    depends on NOE

config NOE_QDMATX_QDMARX
    bool
    depends on NOE_QDMA

config HW_SFQ
    bool
    depends on NOE_QDMA

config  ESW_DOUBLE_VLAN_TAG
    bool
    default n

config ETH_SKB_ALLOC_SELECT
    bool
    default y

#choice
#    prompt "SKB Allocation API Selection"
#    depends on ETH_SKB_ALLOC_SELECT
#    default ETH_SLAB_ALLOC_SKB

config  ETH_SLAB_ALLOC_SKB
    #bool "SLAB skb allocation"
    bool
    default y

config  ETH_PAGE_ALLOC_SKB
    #bool "Page skb allocation"
    bool
    default n

#endchoice

config NOE_TX_RX_INT_SEPARATION
    bool "Interrupt Separation"
    depends on MP_PLATFORM_INT_1_to_1_SPI
    default n


config NOE_FLUSH_MEM
    bool
    default n

endif # NOE
```

## drivers/mstar2/drv/pcie/Kconfig
```kconfig
config MSTAR_PCIE
	bool "MSTAR_PCIE"
	depends on PCI && (MSTAR_KANO||MSTAR_K6)
	help
	  Say Y here if you want the MStar PCIe host core. Select this if you are having a
	  problem with PCI support and want to see more of what is going on.

	  When in doubt, say N.

config MSTAR_PCIE_DISABLE_DIRECT_MMIO
	bool "Disable direct MMIO"
	depends on MSTAR_PCIE && MSTAR_K6
	default n
	help
	  Disable direct MMIO mode.
```

## drivers/mstar2/drv/pm/Kconfig
```kconfig
config MSTAR_PM

bool "PM"

select APM_EMULATION

help
    MStar PM driver function
```

## drivers/mstar2/drv/pnl_cust/Kconfig
```kconfig
config MP_PNL_STR_CUST
bool "PNL_STR_CUST"
default n
---help---
Enable Panel STR customerized power sequence
```

## drivers/mstar2/drv/pwm/Kconfig
```kconfig
config MSTAR_PWM


tristate "PWM"
default n

config MTKPVR_PWM

bool "PVR_PWM"
default n

---help---
Enable compilation option for driver PWM
```

## drivers/mstar2/drv/qos/Kconfig
```kconfig
config MP_QOS
    tristate "CPUQoS v1.0 for TV"
    default n
    help
      CPU QoS v1.0 for dynamic feature control
```

## drivers/mstar2/drv/r2/Kconfig
```kconfig
config MSTAR_R2
bool "R2"
default n
help
    MStar R2 driver function

if MSTAR_R2
    config MSTAR_FRC_R2
    bool "FRC R2"
    default n
endif
```

## drivers/mstar2/drv/regulator/Kconfig
```kconfig
config REGULATOR_MTKTV
    tristate "Meditak Regulator control"
    depends on ARM_MTKTV_CPUFREQ
    help
        This driver provide cpu power control
```

## drivers/mstar2/drv/rtc/Kconfig
```kconfig
config MSTAR_RTC

tristate "RTC"
#depends on WATCHDOG
default y
select RTC_CLASS
help
    MStar RTC driver function
```

## drivers/mstar2/drv/sem/Kconfig
```kconfig
config MSTAR_HW_SEM

tristate "HW Sem"
help
    MStar IIC driver HW Sem function
```

## drivers/mstar2/drv/semutex/Kconfig
```kconfig
config MSTAR_SEMUTEX

tristate "SEMUTEX"

help
    MStar MsOS driver function
default y
```

## drivers/mstar2/drv/system/Kconfig
```kconfig
config MSTAR_SYSTEM
	tristate "System"
	select CRC32
  default y

config MSTAR_UTOPIA2K_MDEBUG
	bool "UTOPIA2K_MDEBUG"
  default n

config MSTAR_SUPPORT_MULTI_GATE
        bool "Support Multi Gate"
  default n
```

## drivers/mstar2/drv/taskstatus/Kconfig
```kconfig
config MP_FindTaskStatus
	bool "Find Task Status"
	default n
	help
		Find Task Status
```

## drivers/mstar2/drv/tch/Kconfig
```kconfig
config SUPPORT_TCH
bool "Support TCH Vision"
default n
help
    enable TCH vision

config MSTAR_XC_TCH_HDR_1_3_0
bool "XC TCH HDR Support 1_3_0"
default n
help
    enable MStar XC TCH HDR Support 1_3_0

config MSTAR_XC_TCH_HDR_1_4_3
bool "XC TCH HDR Support 1_4_3"
default n
help
    enable MStar XC TCH HDR Support 1_4_3
```

## drivers/mstar2/drv/tee_shm/Kconfig
```kconfig
config MSTAR_TEE_SHM

tristate "TEE_SHM"

help
    MStar TEE_SHM driver function
default y
```

## drivers/mstar2/drv/thermal/Kconfig
```kconfig
config MTKTV_CPU_THERMAL
    tristate "MTKTV CPU THERMAL"
    depends on THERMAL
    default n
    help
        MTKTV CPU THERMAL CONTROL
```

## drivers/mstar2/drv/ufs/Kconfig
```kconfig
config MSTAR_UFS
	tristate "MSTAR UFS controller platform driver"
	depends on SCSI && SCSI_DMA
	
	select SCSI_LOWLEVEL
	select SCSI_UFSHCD
	select SCSI_UFSHCD_PLATFORM
  default n
	help
	  This selects the MSTAR specific additions to UFSHCD platform driver.
	  UFS host on MSTAR needs some vendor specific configuration before
	  accessing the hardware which includes PHY configuration and vendor
	  specific registers.

	  Select this if you have UFS controller on MSTAR chipset.
	  If unsure, say N.

config MSTAR_UFS_DEBUG
	tristate "MSTAR UFS debugging"
	depends on MSTAR_UFS

  default n
	help
      If you are experiencing any problems with the UFS device, say
        Y here.  This will result in _many_ additional debugging messages.
```

## drivers/mstar2/drv/util/Kconfig
```kconfig
config MSTAR_UTIL
	tristate "MSTAR_UTIL"
	default m
	help
    		enable MStar util driver.
```
