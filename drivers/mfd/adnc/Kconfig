## drivers/mstar2/drv/CPU_calibrating/Kconfig
```kconfig
config MSTAR_DVFS_DEBUG
    bool "Mstar DVFS engine debug"
    depends on MSTAR_DVFS
    default y

choice
	prompt "Mstar CPU calibrating"
	default MSTAR_CPU_CALIBRATING_NONE
    depends on CPU_FREQ

config MSTAR_CPU_CALIBRATING_NONE
    bool "None"

config MSTAR_CPU_CLUSTER_CALIBRATING
    bool "Mstar CPU cluster calibrating"
    depends on CPU_FREQ
    default n
    help
      MStar CPU cluster calibrating driver function. If you need to
      set multi-cluster CPUs frequency, you can use this option.
      For example : big.LITTLE CPU, two clusters CPU frequency.
endchoice
```

## drivers/mstar2/drv/alsa_audio_driver/Kconfig
```kconfig
# drivers/mstar/drv/alsa_audio_driver/Kconfig

menuconfig MSTAR_ALSA_AUDIO_DRIVER
	tristate "ALSA Audio Driver"
	default n
	depends on SND
	select SND_SOC
	help
		MStar ALSA Audio Driver.

		Note!
		Before enable "MStar ASLA Audio Driver",
		be remembered to enable "Linux ALSA Kernel Module" first,
		and enable the required modules then.

		[Device Driver]->[Sound card support]->[Advanced Linux Sound Architecture]->...

if MSTAR_ALSA_AUDIO_DRIVER

config MSTAR_ALSA_AUDIO_DRIVER_DRV
	tristate "ALSA Audio Driver - DRV Layer"
	default y
	depends on MSTAR_ALSA_AUDIO_DRIVER
	help
		MStar ALSA Audio Driver - DRV Layer.

config MSTAR_ALSA_AUDIO_DRIVER_HAL
	tristate "ALSA Audio Driver - HAL Layer"
	default y
	depends on MSTAR_ALSA_AUDIO_DRIVER_DRV
	help
		MStar ALSA Audio Driver - HAL Layer.

endif #MSTAR_ALSA_AUDIO_DRIVER
```

## drivers/mstar2/drv/armce_test/Kconfig
```kconfig
config MP_ARMCE_TEST
	bool "Arm Crypto Extension booting test"
	default n
	help
		Arm Crypto Extension booting test
```

## drivers/mstar2/drv/backlight/Kconfig
```kconfig
config MSTAR_SYSFS_BACKLIGHT
bool "Sysfs backlight control"
select BACKLIGHT_LCD_SUPPORT
select BACKLIGHT_CLASS_DEVICE
default n

---help---
Enable backlight control in sysfs for Mstar platform
```

## drivers/mstar2/drv/bw/Kconfig
```kconfig
config MTK_MIU_BW
    tristate "Mediatek DTV SoCs Bandwidth"
    default y
    help
      This driver, memory interface unit protection, is for the Memory
      Controller module in MediaTek SoCs, mainly help enable/disable
      memory protect unit. This controller is used to handle kernel
      memory protect merge and split to let others module use memory.
```

## drivers/mstar2/drv/cma_pool/Kconfig
```kconfig
config MSTAR_CMAPOOL
	bool  "CMA POOL"
	depends on CMA
	select MSTAR_MIU
	select MP_PLATFORM_UTOPIA2_INTERRUPT

	help
		MStar CMA POOL driver function

config MSTAR_MIUSLITS
	bool  "MIU SLITS"
	depends on MSTAR_CMAPOOL
	select MSTAR_MIU
	default n

	help
		CMA HEAP kernel protected by MIU SLits
```

## drivers/mstar2/drv/cpufreq/Kconfig
```kconfig
config ARM_MTKTV_CPUFREQ
    bool "Mediatek Dynamic Voltage and Frequency Scaling"
    depends on CPU_FREQ
    select PM_OPP
    help
        To enable or to disable Mediatek dynamic voltage and frequency scaling mechanism

config ARM_MTKTV_CPUFREQ_CA
    bool "Mediatek Dynamic Secure Voltage and Frequency Control"
    depends on (ARM_MTKTV_CPUFREQ)
    default n
    help
        To enable or to disable Mediatek dynamic voltage and frequency secure control
```

## drivers/mstar2/drv/dfc/Kconfig
```kconfig
config MSTAR_DFC

tristate "MSTAR DFC"

help
    MStar DRAM frequency change
default n
```

## drivers/mstar2/drv/dmic/Kconfig
```kconfig
# drivers/mstar/drv/dmic/Kconfig

menuconfig MSTAR_DMIC_DRIVER
	tristate "Dmic Driver"
	default n
	depends on SND
	select SND_SOC
	help
		MStar Dmic Driver.

		Note!
		Before enable "MStar Dmic Driver",
		be remembered to enable "Linux ALSA Kernel Module" first,
		and enable the required modules then.

		[Device Driver]->[Sound card support]->[Advanced Linux Sound Architecture]->...

if MSTAR_DMIC_DRIVER

config MSTAR_DMIC_DRIVER_DRV
	tristate "Dmic Driver - DRV Layer"
	default y
	depends on MSTAR_DMIC_DRIVER
	help
		MStar Dmic Driver - DRV Layer.

config MSTAR_DMIC_DRIVER_HAL
	tristate "Dmic Driver - HAL Layer"
	default y
	depends on MSTAR_DMIC_DRIVER_DRV
	help
		MStar Dmic Driver - HAL Layer.

endif #MSTAR_DMIC_DRIVER
```

## drivers/mstar2/drv/dolby/Kconfig
```kconfig
config SUPPORT_DV
bool "Support Dolby Vision"
default n
help
    enable dolby vision

config MSTAR_XC_HDR_1_4_0
bool "XC HDR Support 1_4_0"
default n
help
    enable MStar XC HDR Support 1_4_0

config MSTAR_XC_HDR_1_4_2
bool "XC HDR Support 1_4_2"
default n
help
    enable MStar XC HDR Support 1_4_2

config MSTAR_XC_HDR_1_5_1
bool "XC HDR Support 1_5_1"
default n
help
    enable MStar XC HDR Support 1_5_1

config MSTAR_XC_HDR_1_6_1_1
bool "XC HDR Support 1_6_1_1"
default n
help
    enable MStar XC HDR Support 1_6_1_1
```

## drivers/mstar2/drv/dvfs/Kconfig
```kconfig
config MSTAR_DVFS
bool "Mstar Dynamic Voltage and Frequency Scaling"
depends on CPU_FREQ
default n

---help---
    To enable or to disable Mstar dynamic voltage and frequency scaling mechanism

if MSTAR_DVFS

choice
    prompt "selection menu"
    default MSTAR_SEL_DVFS
    help
    To enable Mstar Dynamic Voltage and Frequency Scaling or Dynamic Frequency Scaling.

config MSTAR_SEL_DVFS
    bool "DVFS"
    select IS_MSTAR_DVFS
    help
    To enable Mstar Dynamic Voltage and Frequency Scaling.

config MSTAR_SEL_DFS
    bool "DFS"
    select IS_MSTAR_DFS
    help
    To enable Mstar Dynamic Frequency Scaling.
endchoice

endif

config MSTAR_DVFS_FIXED_CPU_CLOCK
bool "Enable Fixed CPU Clock Mechanism"
depends on MSTAR_DVFS
default n

---help---
    To enable or to disable fixed CPU clock mechanism

config MSTAR_DVFS_BOOT_TIME_MANUAL
bool "Enable DVFS Boot time manual setting"
depends on MSTAR_DVFS
default n

---help---
    To enable or to disable DVFS Boot time manual setting

config DVFS_BOOT_MODE_TIME
    int "Mstar DVFS boot time"
    depends on MSTAR_DVFS_BOOT_TIME_MANUAL
    default 30
    range 0 100
---help---
    Adjustment boot time value

config DVFS_DETACH_BOOST_FREQ_AND_MAX_FREQ
bool "Detach Boost Frequency and Maximum Frequency"
depends on MSTAR_DVFS
default n

config MSTAR_DVFS_PROTECT_ONLY
bool "Only Temperature Protection"
depends on MSTAR_DVFS
default n

config MSTAR_DVFS_KERNEL_IIC
bool "DVFS using kernel mode IIC"
depends on MSTAR_DVFS
default n

---help---
    Select if DVFS using kernel mode IIC

if MSTAR_DVFS_KERNEL_IIC

choice
    prompt "selection menu"
    default MSTAR_DVFS_KERNEL_HWIIC
    help
    To select HW IIC or SW IIC for DVFS.

config MSTAR_DVFS_KERNEL_HWIIC
    bool "HW IIC"
    select IS_MSTAR_DVFS_HWIIC
    help
    To enable HW IIC for DVFS.

config MSTAR_DVFS_KERNEL_SWIIC
    bool "SW IIC"
    select IS_MSTAR_DVFS_SWIIC
    help
    To enable SW IIC for DVFS.
endchoice

endif
```

## drivers/mstar2/drv/fusion_mtk/Kconfig
```kconfig
config MTK_FUSION_MTK
	tristate "Fusion(MTK)"
	---help---
	  Fusion is the IPC API used by DirectFB and FusionSound.
```

## drivers/mstar2/drv/gmac/Kconfig
```kconfig
config MSTAR_GMAC
select NET
select NET_ETHERNET
select MII
select PACKET
select USE_POLICY_FWD
select INET
select NETDEVICES

tristate "GMAC"
default n

---help---
Enable compilation option for driver GMAC

if MSTAR_GMAC
config MSTAR_GMAC_V3
bool "GMAC V3"
default n
help
    GMAC Experimental driver. K6, K6lite, K7 support

if MSTAR_GMAC_V3
choice
    prompt "Kano Default Select PadMux"
    default KANO_GMAC1_EPHY
    depends on MSTAR_KANO

config KANO_GMAC1_EPHY
bool "GMAC1 + Internal EPHY"
help
    GMAC1 + Internal EPHY

config KANO_GMAC1_GPHY
bool "GMAC1 + external GPHY"
help
    GMAC1 + external GPHY

config KANO_GMAC0_GPHY
bool "GMAC0 + external GPHY"
help
    GMAC0 + external GPHY

endchoice

config KANO_GMAC0_GPHY_PHY_ADDR
int "GMAC0 tO GPHY PHY address"
default 0
depends on MSTAR_KANO
help
    GMAC0 + external GPHY PHY address

config KANO_GMAC1_EPHY_PHY_ADDR
int "GMAC1 tO EPHY PHY address"
default 0
depends on MSTAR_KANO
help
    GMAC1 + Internal EPHY PHY address

config KANO_GMAC1_GPHY_PHY_ADDR
int "GMAC1 to GPHY PHY address"
default 0
depends on MSTAR_KANO
help
    GMAC1 + external GPHY PHY address

choice
    prompt "K7U Default Select PadMux"
    default K7U_GMAC1_GPHY
    depends on MSTAR_K7U

config K7U_GMAC1_GPHY
bool "GMAC1 + Internal GPHY"
help
    GMAC1 + Internal GPHY

config K7U_GMAC1_PM
bool "GMAC1 + external GPHY from PM"
help
    GMAC1 + external GPHY from PM

config K7U_GMAC0_PM
bool "GMAC0 + external GPHY from PM"
help
    GMAC0 + external GPHY from PM

config K7U_GMAC0_CHIPTOP
bool "GMAC0 + external GPHY from CHIPTOP"
help
    GMAC0 + external GPHY from CHIPTOP

endchoice

config GMAC0_CHIPTOP_PHY_ADDR
int "GMAC0 tO CHIPTOP PHY address"
default 1
depends on MSTAR_K7U
help
    GMAC0 + external GPHY from CHIPTOP PHY address

config GMAC0_PM_PHY_ADDR
int "GMAC0 tO PM PHY address"
default 0
depends on MSTAR_K7U
help
    GMAC0 + external GPHY from PM PHY address

config GMAC1_GPHY_PHY_ADDR
int "GMAC1 to GPHY PHY address"
default 0
depends on MSTAR_K7U
help
    GMAC1 + Internal GPHY PHY address

config GMAC1_PM_PHY_ADDR
int "GMAC1 to PM PHY address"
default 2
depends on MSTAR_K7U
help
    GMAC1 + external GPHY from PM PHY address

config GPHY_INIT_IN_SBOOT
bool "Init GPHY in sboot"
default n
depends on MSTAR_K7U
help
    Move GPHY init to sboot for saving auto negotiation time

config GMAC_GPHY_TO_EPHY
bool "GPHY to EPHY mode"
default n
depends on MSTAR_K7U
help
    Change GPHY to EPHY mode with speed support 10/100

choice
    prompt "Select RX Method"
    default GMAC_RX_DMA if MSTAR_K7U
    default GMAC_RX_Memory_Copy

config GMAC_RX_Memory_Copy
bool "Memory_Copy"
help
    Use memcpy and additional RX buffer for RX callback function

config GMAC_RX_DMA
bool "DMA"
help
    GMAC Direct access Kernel Memory in RX callback function.
    K6, K6lite, k7 can only use one MIU for kernel Memory.

endchoice

config GMAC_RX_NAPI
bool "Enable RX_NAPI"
default y
help
    Enable NAPI Method. Disable interrupt during heavy tracffic.

if GMAC_RX_NAPI
config GMAC_RX_NAPI_WEIGHT
int "RX_NAPI_WEIGHT"
default 64
help
    NAPI Weight

config GMAC_RX_GRO
bool "Enable RX_GRO"
default y
help
    Enable Generic receive offload. Merge packet with same destination and source

endif

config GMAC_RX_DELAY_INTERRUPT
bool "Enable RX Delay Interrupt"
default y
help
    Enable RX Delay Interrupt. Reduce interrupt number.

if GMAC_RX_DELAY_INTERRUPT
config GMAC_DELAY_INTERRUPT_NUMBER
int "Packet Threshold"
default 64
help
    MAX 255

config GMAC_DELAY_INTERRUPT_TIMEOUT
int "Timeout"
default 6
help
    MAX 255

endif

choice
    prompt "Select TX Queue"
    default GMAC_TX_DESC_MODE if MSTAR_K7U
    default GMAC_TX_4_QUEUE

config GMAC_TX_4_QUEUE
bool "Default TX Queue"
help
    Use default TX Queue 4.

config GMAC_NEW_TX_QUEUE_V3
bool "Enable Additional New TX Queue"
depends on MSTAR_K7U || MSTAR_K6 || MSTAR_C2P
help
    Enable New TX Queue. Larger TX Queue. Kayla support

config GMAC_TX_DESC_MODE
bool "Enable TX dexcriptor Mode"
depends on MSTAR_K7U || MSTAR_C2P
help
    Enable TX dexcriptor Mode. Use DRAM for TX QUEUE.

endchoice

config GMAC_NEW_TX_QUEUE_THRESHOLD_V3
int "New TX Queue Threshold"
default 60
depends on GMAC_NEW_TX_QUEUE_V3
help
    MAX 63

endif

config MSTAR_GMAC_V2
bool "GMAC V2"
default n
depends on !MSTAR_GMAC_V3
help
    GMAC V2 architecture. Zero memcpy in RX, pre-allocate ring buffer

config GMAC_SUPPLY_RNG
bool "Supply to random number generator device"
default n
depends on !MSTAR_GMAC_V3
help
    Supply to random number generator device

config GMAC_ETHERNET_ALBANY
bool "Supply to internel PHY"
default n
depends on !MSTAR_GMAC_V3
help
    Supply to internel PHY

config MSTAR_GMAC_HW_TX_CHECKSUM
bool "Supply to hardware TX checksum"
default n
help
    Supply to hardware TX checksum

config MSTAR_GMAC_JUMBO_PACKET
bool "Supply to jumbo packet"
default n
depends on !MSTAR_GMAC_V3
help
    Supply to jumbo packet

config MSTAR_GMAC_RMII_DOWNGRADE_MODE
bool "Supply GMAC to use external EPHY by RMII"
default n
depends on !MSTAR_GMAC_V3
help
    Supply to GMAC use external RMII EPHY
endif
```

## drivers/mstar2/drv/gpio/Kconfig
```kconfig
config MSTAR_GPIO

tristate "GPIO"
depends on GPIOLIB
help
    MStar GPIO driver function

config MSTAR_GPIO_SUSPEND
tristate "GPIO_SUSPEND"
depends on MSTAR_GPIO
default n
help
    enable MStar GPIO suspend

menu "GPIO_Interrupt"
choice
	prompt "Interrupt"
	default NON_INTERRUPT
config NON_INTERRUPT
 bool "no-interrupt"
config EXT_INTERRUPT_SUPPORT
	bool "ext-gpio-interrupt"

endchoice
endmenu
```

## drivers/mstar2/drv/hdmitx4vx1/Kconfig
```kconfig
config MSTAR_HDMITX4VX1
tristate "MSTAR_HDMITX4VX1"
default n
help
    enable MStar Vx1 to HDMITX driver.
```

## drivers/mstar2/drv/hdr10plus_ref/Kconfig
```kconfig
config SUPPORT_HDR10PLUS_REF
bool "Support HDR10PLUS_REF version"
default n
help
    enable HDR10PLUS_REF version
```

## drivers/mstar2/drv/iic/Kconfig
```kconfig
config MSTAR_IIC

tristate "SWIIC"
select MSTAR_GPIO
#select MSTAR_HW_SEM
help
    MStar IIC driver function
```

## drivers/mstar2/drv/iommu/Kconfig
```kconfig
config MSTAR_IOMMU
tristate "MSTAR_IOMMU"
default n
help
    enable MStar smart card driver.
```

## drivers/mstar2/drv/ir_mirc/Kconfig
```kconfig
config MSTAR_IR_REFACTOR
	tristate "Mstar IR Driver"
	default y
	help
	  Mstar IR decoder driver function

menu "Mstar IR Config"
	depends on MSTAR_IR_REFACTOR

config IR_DYNAMIC_CONFIG
        depends on MIRC_INPUT_DEVICE
	tristate "load ir config(header,protocol,keymap)"
	default n

config IR_CONFIG_PATH
	depends on IR_DYNAMIC_CONFIG
	string "path to ir config"
	default "/config/ir_config.ini"
	help
	  Please set the path to ir_config.ini.

config MIRC_INPUT_DEVICE
	bool "IR Key send to input subsystem"
	default y

config IR_DISABLE_REPEAT
	bool "Disable IR repeat key"
	default n
	help
	  Set y to bypass repeat key

if MIRC_INPUT_DEVICE
source "drivers/mstar2/drv/ir_mirc/keymaps/Kconfig"
endif

endmenu
```

## drivers/mstar2/drv/ir_mirc/keymaps/Kconfig
```kconfig
menu "Mstar IR Keymap Select"
    depends on MIRC_INPUT_DEVICE
	config IR_KEYMAP_MSTAR_NEC
		bool "Mstar NEC keymaps"
		default y
		help
		Mstar nec keymap
	config IR_KEYMAP_TCL_RCA
		bool "TCL RCA keymaps"
		default y
		help
		TCL RCA keymaps
	config IR_KEYMAP_TCL
		bool "TCL keymaps"
		default y
		help
		TCL tv keymaps
	config IR_KEYMAP_GOME_NEC
		bool "GOME keymaps"
		default y
		help
		GOME tv keymaps
	config IR_KEYMAP_CHANGHONG
		bool "Changhong IR keymaps"
		default y
		help
		Changhong tv keymaps
	config IR_KEYMAP_HISENSE
		bool "Hisense IR keymaps"
		default y
		help
		Hisense tv keymaps
	config IR_KEYMAP_HAIER
		bool "Haier IR keymaps"
		default y
		help
		Haier tv keymaps
	config IR_KEYMAP_KONKA
		bool "Konka IR keymaps"
		default y
		help
		Konka tv keymaps
	config IR_KEYMAP_SKYWORTH
		bool "Skyworth IR keymaps"
		default y
		help
		Skyworth tv keymaps
	config IR_KEYMAP_PANASONIC_7051
		bool "Pnasonic 7051 IR keymaps"
		default y
		help
		panasonic tv keymaps
	config IR_KEYMAP_KATHREIN
		bool "Kathrein RC6 MODE_6A IR keymaps"
		default y
		help
		Kathrein tv keymaps
	config IR_KEYMAP_RC5
		bool "RC5 IR keymaps"
		default y
		help
		RC5 tv keymaps
	config IR_KEYMAP_METZ
		bool "metz IR keymaps"
		default y
		help
		metz tv keymaps
	config IR_KEYMAP_SAMPO
		bool "Sampo IR keymaps"
		default y
		help
		Sampo tv keymaps
    config IR_KEYMAP_BEKO_RC5
        bool "Beko RC5 IR keymaps"
        default y
        help
        Beko RC5 tv keymaps
endmenu
```

## drivers/mstar2/drv/leds/Kconfig
```kconfig
config HAS_LED
	tristate "TV Status Led"
	default n
	help
	    enable MStar tv status led driver.
```

## drivers/mstar2/drv/lp_standby/Kconfig
```kconfig
config MSTAR_LP_STANDBY

bool "Support Mstar low power standby mode"

help
    Support Mstar low power standby mode
default n

config MSTAR_MIU_AUTO_STR

bool "Support Mstar MIU auto str mode"

help
    Support Mstar MIU auto str mode
default n
```
