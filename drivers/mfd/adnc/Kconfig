## drivers/mstar2/Kconfig
```kconfig
# drivers/MStar/Kconfig

menu "MStar Platform Configuration"

#===================================================
# MStar Chip Selection
#===================================================
choice
	prompt "MStar Chip Selection"
	default None

config MSTAR_NONE
	bool "None"

config MSTAR_CLIPPERS
        bool "CLIPPERS"
        select ARCH_WANT_OPTIONAL_GPIOLIB
        select ARM_AMBA
        select ARM_TIMER_SP804
        select COMMON_CLKDEV
        select HAVE_CLK
        select ICST
        select PLAT_VERSATILE
        help
          This enables support for the ARM Ltd Versatile Express boards.

config MSTAR_MUJI
        bool "MUJI"
        select ARCH_WANT_OPTIONAL_GPIOLIB
        select ARM_AMBA
        select ARM_TIMER_SP804
        select COMMON_CLKDEV
        select HAVE_CLK
        select ICST
        select PLAT_VERSATILE
        help
          This enables support for the Muji 64 bit mode kernel.

config MSTAR_KANO
        bool "KANO"
        select ARCH_WANT_OPTIONAL_GPIOLIB
        select ARM_AMBA
        select ARM_TIMER_SP804
        select COMMON_CLKDEV
        select HAVE_CLK
        select ICST
        select PLAT_VERSATILE
        select MIGHT_HAVE_PCI
        select PCI
        help
          This enables support for the Kano 64 bit mode kernel.

config MSTAR_CURRY
        bool "CURRY"
        select ARCH_WANT_OPTIONAL_GPIOLIB
        select ARM_AMBA
        select ARM_TIMER_SP804
        select COMMON_CLKDEV
        select HAVE_CLK
        select ICST
        select PLAT_VERSATILE
        select MIGHT_HAVE_PCI
        select PCI
        help
          This enables support for the Curry 64 bit mode kernel.

config MSTAR_C2P
        bool "C2P"
        select ARCH_WANT_OPTIONAL_GPIOLIB
        select ARM_AMBA
        select ARM_TIMER_SP804
        select COMMON_CLKDEV
        select HAVE_CLK
        select ICST
        select PLAT_VERSATILE
        select MIGHT_HAVE_PCI
        select PCI
        help
          This enables support for the C2P 64 bit mode kernel.

config MSTAR_K6
        bool "K6"
        select ARCH_WANT_OPTIONAL_GPIOLIB
        select ARM_AMBA
        select ARM_TIMER_SP804
        select COMMON_CLKDEV
        select HAVE_CLK
        select ICST
        select PLAT_VERSATILE
        select MIGHT_HAVE_PCI
        select PCI
        help
          This enables support for the K6 64 bit mode kernel.

config MSTAR_K6Lite
        bool "K6Lite"
        select ARCH_WANT_OPTIONAL_GPIOLIB
        select ARM_AMBA
        select ARM_TIMER_SP804
        select COMMON_CLKDEV
        select HAVE_CLK
        select ICST
        select PLAT_VERSATILE
        help
          This enables support for the ARM Ltd Versatile Express boards.

config MSTAR_K7U
        bool "K7U"
        select ARCH_WANT_OPTIONAL_GPIOLIB
        select ARM_AMBA
        select ARM_TIMER_SP804
        select COMMON_CLKDEV
        select HAVE_CLK
        select ICST
        select PLAT_VERSATILE
        select MIGHT_HAVE_PCI
        select PCI
        help
          This enables support for the K7U 64 bit mode kernel.

config MSTAR_MONET
        bool "MONET"
        select ARCH_WANT_OPTIONAL_GPIOLIB
        select ARM_AMBA
        select ARM_TIMER_SP804
        select COMMON_CLKDEV
        select HAVE_CLK
        select ICST
        select PLAT_VERSATILE
        help
          This enables support for the Monet 64 bit mode kernel.

config MSTAR_MOONEY
        bool "MOONEY"
        select ARCH_WANT_OPTIONAL_GPIOLIB
        select ARM_AMBA
        select ARM_TIMER_SP804
        select COMMON_CLKDEV
        select HAVE_CLK
        select ICST
        select PLAT_VERSATILE
        help
          This enables support for the Mooney 64 bit mode kernel.

config MSTAR_M7221
        bool "M7221"
        select ARCH_WANT_OPTIONAL_GPIOLIB
        select ARM_AMBA
        select ARM_TIMER_SP804
        select COMMON_CLKDEV
        select HAVE_CLK
        select ICST
        select PLAT_VERSATILE
        help
          This enables support for the M7221 64 bit mode kernel.

config MSTAR_M7322
        bool "M7322"
        select ARCH_WANT_OPTIONAL_GPIOLIB
        select ARM_AMBA
        select ARM_TIMER_SP804
        select COMMON_CLKDEV
        select HAVE_CLK
        select ICST
        select PLAT_VERSATILE
        help
          This enables support for the M7322 64 bit mode kernel.

config MSTAR_MANHATTAN
        bool "MANHATTAN"
        select ARCH_WANT_OPTIONAL_GPIOLIB
        select ARM_AMBA
        select ARM_TIMER_SP804
        select COMMON_CLKDEV
        select HAVE_CLK
        select ICST
        select PLAT_VERSATILE
        help
          This enables support for the MANHATTAN 64 bit mode kernel.

config MSTAR_MASERATI
        bool "MASERATI"
        select ARCH_WANT_OPTIONAL_GPIOLIB
        select ARM_AMBA
        select ARM_TIMER_SP804
        select COMMON_CLKDEV
        select HAVE_CLK
        select ICST
        select PLAT_VERSATILE
        help
          This enables support for the MASERATI 64 bit mode kernel.

config MSTAR_MAXIM
        bool "MAXIM"
        select ARCH_WANT_OPTIONAL_GPIOLIB
        select ARM_AMBA
        select ARM_TIMER_SP804
        select COMMON_CLKDEV
        select HAVE_CLK
        select ICST
        select PLAT_VERSATILE
        help
          This enables support for the MAXIM 64 bit mode kernel.

config MSTAR_M7621
        bool "M7621"
        select ARCH_WANT_OPTIONAL_GPIOLIB
        select ARM_AMBA
        select ARM_TIMER_SP804
        select COMMON_CLKDEV
        select HAVE_CLK
        select ICST
        select PLAT_VERSATILE
        help
          This enables support for the M7621 64 bit mode kernel.

config MSTAR_M7622
        bool "M7622"
        select ARCH_WANT_OPTIONAL_GPIOLIB
        select ARM_AMBA
        select ARM_TIMER_SP804
        select COMMON_CLKDEV
        select HAVE_CLK
        select ICST
        select PLAT_VERSATILE
        help
          This enables support for the M7621 64 bit mode kernel.

config MSTAR_M5621
        bool "M5621"
        select ARCH_WANT_OPTIONAL_GPIOLIB
        select ARM_AMBA
        select ARM_TIMER_SP804
        select COMMON_CLKDEV
        select HAVE_CLK
        select ICST
        select PLAT_VERSATILE
        help
          This enables support for the M5621 64 bit mode kernel.

config MSTAR_M7821
        bool "M7821"
        select ARCH_WANT_OPTIONAL_GPIOLIB
        select ARM_AMBA
        select ARM_TIMER_SP804
        select COMMON_CLKDEV
        select HAVE_CLK
        select ICST
        select PLAT_VERSATILE
        select PCI
        help
          This enables support for the M7821 64/32 bit mode kernel.

config MSTAR_M3822
        bool "M3822"
        select ARCH_WANT_OPTIONAL_GPIOLIB
        select ARM_AMBA
        select ARM_TIMER_SP804
        select COMMON_CLKDEV
        select HAVE_CLK
        select ICST
        select PLAT_VERSATILE
        help
          This enables support for the M3822 32 bit mode kernel

config MSTAR_M7632
        bool "M7632"
        select ARCH_WANT_OPTIONAL_GPIOLIB
        select ARM_AMBA
        select ARM_TIMER_SP804
        select COMMON_CLKDEV
        select HAVE_CLK
        select ICST
        select PLAT_VERSATILE
        help
          This enables support for the M7632 32/64 bit mode kernel

config MSTAR_M7332
        bool "M7332"
        select ARCH_WANT_OPTIONAL_GPIOLIB
        select ARM_AMBA
        select ARM_TIMER_SP804
        select COMMON_CLKDEV
        select HAVE_CLK
        select ICST
        select PLAT_VERSATILE
        help
          This enables support for the M7332 64 bit mode kernel.

config MSTAR_M7642
        bool "M7642"
        select ARCH_WANT_OPTIONAL_GPIOLIB
        select ARM_AMBA
        select ARM_TIMER_SP804
        select COMMON_CLKDEV
        select HAVE_CLK
        select ICST
        select PLAT_VERSATILE
        help
          This enables support for the M7642 32/64 bit mode kernel

config MSTAR_MT5862
        bool "MT5862"
        select ARCH_WANT_OPTIONAL_GPIOLIB
        select ARM_AMBA
        select ARM_TIMER_SP804
        select COMMON_CLKDEV
        select HAVE_CLK
        select ICST
        select PLAT_VERSATILE
        help
          This enables support for the MT5862 64 bit mode kernel.

config MSTAR_MT5867
	bool "MT5867"
	select ARCH_WANT_OPTIONAL_GPIOLIB
	select ARM_AMBA
	select ARM_TIMER_SP804
	select COMMON_CLKDEV
	select HAVE_CLK
	select ICST
	select PLAT_VERSATILE
	help
	 This enables support for the MT5867 32/64 bit mode kernel.

config MSTAR_MT5889
        bool "MT5889"
        select ARCH_WANT_OPTIONAL_GPIOLIB
        select ARM_AMBA
        select ARM_TIMER_SP804
        select COMMON_CLKDEV
        select HAVE_CLK
        select ICST
        select PLAT_VERSATILE
        help
          This enables support for the MT5862 64 bit mode kernel.

config MSTAR_MT5872
	bool "MT5872"
	select ARCH_WANT_OPTIONAL_GPIOLIB
	select ARM_AMBA
	select ARM_TIMER_SP804
	select COMMON_CLKDEV
	select HAVE_CLK
	select ICST
	select PLAT_VERSATILE
	help
	 This enables support for the MT5872 32/64 bit mode kernel.

config MSTAR_MAINZ
        bool "MAINZ"
        select ARCH_WANT_OPTIONAL_GPIOLIB
        select ARM_AMBA
        select ARM_TIMER_SP804
        select COMMON_CLKDEV
        select HAVE_CLK
        select ICST
        select PLAT_VERSATILE
        select MP_PLATFORM_MAINZ_PATCH
        help
          This enables support for the MAINZ 64 bit mode kernel.


config MSTAR_MONACO
        bool "MONACO"
        select ARCH_WANT_OPTIONAL_GPIOLIB
        select ARM_AMBA
        select ARM_TIMER_SP804
        select COMMON_CLKDEV
        select HAVE_CLK
        select ICST
        select PLAT_VERSATILE
        help
          This enables support for the ARM Ltd Versatile Express boards.

config MSTAR_MALDIVES
        bool "MALDIVES"
        select ARCH_WANT_OPTIONAL_GPIOLIB
        select ARM_AMBA
        select ARM_TIMER_SP804
        select COMMON_CLKDEV
        select HAVE_CLK
        select ICST
        select PLAT_VERSATILE
        help
          This enables support for the ARM Ltd Versatile Express boards.

config MSTAR_MIAMI
        bool "MIAMI"
        select ARCH_WANT_OPTIONAL_GPIOLIB
        select ARM_AMBA
        select ARM_TIMER_SP804
        select COMMON_CLKDEV
        select HAVE_CLK
        select ICST
        select PLAT_VERSATILE
        help
          This enables support for the ARM Ltd Versatile Express boards.

config MSTAR_MADISON
        bool "MADISON"
        select ARCH_WANT_OPTIONAL_GPIOLIB
        select ARM_AMBA
        select ARM_TIMER_SP804
        select COMMON_CLKDEV
        select HAVE_CLK
        select ICST
        select PLAT_VERSATILE
        help
          This enables support for the ARM Ltd Versatile Express boards.

config MSTAR_MESSI
        bool "MESSI"
        select ARCH_WANT_OPTIONAL_GPIOLIB
        select ARM_AMBA
        select ARM_TIMER_SP804
        select COMMON_CLKDEV
        select HAVE_CLK
        select ICST
        select PLAT_VERSATILE
        help
          This enables support for the ARM Ltd Versatile Express boards.

config MSTAR_MUSTANG
        bool "MUSTANG"
        select ARCH_WANT_OPTIONAL_GPIOLIB
        select ARM_AMBA
        select ARM_TIMER_SP804
        select COMMON_CLKDEV
        select HAVE_CLK
        select ICST
        select PLAT_VERSATILE
        help
          This enables support for the ARM Ltd Versatile Express boards.

config MSTAR_EINSTEIN
        bool "EINSTEIN"
        select ARCH_WANT_OPTIONAL_GPIOLIB
        select ARM_AMBA
        select ARM_TIMER_SP804
        select COMMON_CLKDEV
        select HAVE_CLK
        select ICST
        select PLAT_VERSATILE
        help
          This enables support for the ARM Ltd Versatile Express boards.

config MSTAR_NAPOLI
        bool "NAPOLI"
        select ARCH_WANT_OPTIONAL_GPIOLIB
        select ARM_AMBA
        select ARM_TIMER_SP804
        select COMMON_CLKDEV
        select HAVE_CLK
        select ICST
        select PLAT_VERSATILE
        help
          This enables support for the ARM Ltd Versatile Express boards.

config MSTAR_KAISER
        bool "KAISER"
        select ARCH_WANT_OPTIONAL_GPIOLIB
        select ARM_AMBA
        select ARM_TIMER_SP804
        select COMMON_CLKDEV
        select HAVE_CLK
        select ICST
        select PLAT_VERSATILE
        help
          This enables support for the ARM Ltd Versatile Express boards.

config MSTAR_KRIS
        bool "Kris"
        select BOOT_ELF32
        select ARCH_SPARSEMEM_ENABLE
        select DMA_NONCOHERENT
        select MIPS_BOARDS_GEN
        select CEVT_R4K
        select CSRC_R4K
        select IRQ_CPU
        select SYS_HAS_CPU_MIPS32_R2
        select SYS_HAS_EARLY_PRINTK
        select SYS_SUPPORTS_32BIT_KERNEL
        select SYS_SUPPORTS_BIG_ENDIAN
        select SYS_SUPPORTS_LITTLE_ENDIAN
        select SYS_SUPPORTS_MULTITHREADING
        select HIGHMEM
        select ZONE_DMA
        select MS_USB_MIU1_PATCH
        select SYS_SUPPORTS_HIGHMEM
        select CPU_HAS_SYNC

endchoice

#===================================================
# MStar Chip (auto-select)
# 0: None
# 1: Titania
# 2: Triton
# 3: Titania2
#===================================================
config MSTAR_CHIP_TYPE
	int
	default 1 if MSTAR_TITANIA
	default 2 if MSTAR_TRITON
	default 3 if MSTAR_TITANIA2
	default 4 if MSTAR_OBERON
	default 5 if MSTAR_EUCLID
	default 0

#===================================================
# MStar Chip Name (auto-select)
#===================================================
config MSTAR_CHIP_NAME
	string
	default "einstein" if MSTAR_EINSTEIN
	default "napoli" if MSTAR_NAPOLI
	default "madison" if MSTAR_MADISON
	default "messi" if MSTAR_MESSI
	default "mustang" if MSTAR_MUSTANG
	default "miami" if MSTAR_MIAMI
	default "clippers" if MSTAR_CLIPPERS
	default "monaco" if MSTAR_MONACO
	default "maldives" if MSTAR_MALDIVES
	default "kaiser" if MSTAR_KAISER
	default "muji" if MSTAR_MUJI
	default "muji" if MSTAR_MUJI_32
	default "kano" if MSTAR_KANO
	default "kano" if MSTAR_KANO_32
	default "curry" if MSTAR_CURRY
	default "curry" if MSTAR_CURRY_32
	default "c2p" if MSTAR_C2P
	default "c2p" if MSTAR_C2P_32
	default "monet" if MSTAR_MONET
	default "monet" if MSTAR_MONET_32
	default "manhattan" if MSTAR_MANHATTAN
	default "maserati" if MSTAR_MASERATI
	default "maserati" if MSTAR_MASERATI_32
	default "maxim" if MSTAR_MAXIM
	default "maxim" if MSTAR_MAXIM_32
	default "m7621" if MSTAR_M7621
    default "m7622" if MSTAR_M7622
	default "m7821" if MSTAR_M7821
	default "m5621" if MSTAR_M5621
	default "mainz" if MSTAR_MAINZ
	default "mainz" if MSTAR_MAINZ_32
	default "k6" if MSTAR_K6
	default "k6" if MSTAR_K6_32
        default "k6lite" if MSTAR_K6Lite
	default "k7u" if MSTAR_K7U
	default "k7u" if MSTAR_K7U_32
	default "kris" if MSTAR_KRIS
	default "mooney" if MSTAR_MOONEY
	default "m7221" if MSTAR_M7221
	default "m7322" if MSTAR_M7322
	default "m3822" if MSTAR_M3822
	default "m7632" if MSTAR_M7632
	default "m7332" if MSTAR_M7332
	default "m7642" if MSTAR_M7642
	default "mt5862" if MSTAR_MT5862
	default "mt5867" if MSTAR_MT5867
	default "mt5889" if MSTAR_MT5889
	default "mt5872" if MSTAR_MT5872
	default "error"

#===================================================
# Titania 2 Chip Revision Selection
#===================================================
if MSTAR_TITANIA2
choice
	prompt "-- Titania 2 Chip Revision"
	default None

config MSTAR_TITANIA2_REV_NONE
	bool "None"

config MSTAR_TITANIA2_REV_U02
    bool "U02"

config MSTAR_TITANIA2_REV_U03
    bool "U03"

endchoice
endif

#===================================================
#Chip based define
#===================================================
config MSTAR_ARM
    bool "Enable ARM BASE CPU"
    default n
config MSTAR_MIPS
    bool "Enable MIPS BASE CPU"
	depends on !MSTAR_ARM
    default n


#===================================================
#Android recovery Flag
#===================================================

config WRITE_TO_ANDROID_MISC
    bool "Write Andorid recovery command to partition"
    default n

choice
  depends on WRITE_TO_ANDROID_MISC
	prompt "storage type"
	default EMMC

config WRITE_TO_ANDROID_MISC_EMMC
    bool "EMMC"

config WRITE_TO_ANDROID_MISC_NAND
    bool "NAND"
endchoice

config LX3_SUPPORT
    bool "LX3 support"
    default n

#===================================================
# USB MIU1 PATCH
#===================================================
config MS_USB_MIU1_PATCH
    bool
    default n

#===================================================
# USB NAND PATCH
#===================================================
config MS_NAND_MIU1_PATCH
    bool
    default n

config MSTAR_COOCAA_AUTH
    bool "Link with COOCAA Authorization"
    default n

#===================================================
# CPU HOTPLUG
#===================================================
config MSTAR_CPU_HOTPLUG
    bool "Enable Mstar cpu hotplug"
    depends on HOTPLUG_CPU
    default n


if !MSTAR_NONE
#==========================================
# Remove this latter - cc.chen
#==========================================
source "drivers/mstar2/Kconfig-Board"
source "drivers/mstar2/Kconfig-MMap"


source "drivers/mstar2/Kconfig-CoredumpReboot"
source "drivers/mstar2/Kconfig-Kernel"

#===================================================
# MStar Device Drivers
#===================================================
comment "MStar Device Drivers"

config MSTAR_UDEV_NODE
    bool "use udev to genrate device node"
    default n

config MSTAR_3RD_PARTY
bool "3rd party device list"
if MSTAR_3RD_PARTY
    config MSTAR_TUNER
    tristate "TUNER"
    help
        MStar TUNER driver function

    menu "Tuner device support list"
    depends on MSTAR_TUNER

        config MSTAR_TUNER_Si2151
            bool "MSTAR_TUNER_Si2151"
        config MSTAR_TUNER_MXL661
            bool "MSTAR_TUNER_MXL661"
        config MSTAR_TUNER_AV2018
            bool "MSTAR_TUNER_AV2018"
        config MSTAR_TUNER_AV2017
            bool "MSTAR_TUNER_AV2017"
        config MSTAR_TUNER_AV2012
            bool "MSTAR_TUNER_AV2012"
        config MSTAR_TUNER_R842
            bool "MSTAR_TUNER_R842"
         config MSTAR_TUNER_RT710
            bool "MSTAR_TUNER_RT710"
    endmenu

    config MSTAR_DISH
    tristate "DISH"
    help
        MStar DISH driver function

    menu "DISH device support list"
    depends on MSTAR_DISH

        config MSTAR_DISH_RT5047
            bool "MSTAR_DISH_RT5047"
    endmenu


endif

choice
    prompt "Mstar IR Frame Select"
    default IR_Original
config IR_ORIGINAL_VERSION
    bool "IR_Original"
config IR_REFACTOR_VERSION
    bool "IR_Refactor"
endchoice


config AMAZON_SEC_UART_RX_LOCK
    bool "Amazon Secure UART Rx Lock"
    default n

if IR_ORIGINAL_VERSION
source "drivers/mstar2/drv/ir/Kconfig"
endif
if IR_REFACTOR_VERSION
source "drivers/mstar2/drv/ir_mirc/Kconfig"
endif

#source "drivers/mstar2/gpu/Kconfig"
#source "drivers/mstar/drv/g3d/Kconfig"
source "drivers/mstar2/drv/iomap/Kconfig"
source "drivers/mstar2/drv/bdma/Kconfig"
#source "drivers/mstar/drv/msystem/Kconfig"
source "drivers/mstar2/drv/mpool/Kconfig"
#source "drivers/mstar/drv/ramdisk/Kconfig"
source "drivers/mstar2/drv/gpio/Kconfig"
source "drivers/mstar2/drv/rtc/Kconfig"
source "drivers/mstar2/drv/iic/Kconfig"
source "drivers/mstar2/drv/mspi/Kconfig"
#source "drivers/mstar/drv/hw_sem/Kconfig"
source "drivers/mstar2/drv/emac/Kconfig"
source "drivers/mstar2/drv/system/Kconfig"
source "drivers/mstar2/drv/pwm/Kconfig"
source "drivers/mstar2/drv/backlight/Kconfig"
source "drivers/mstar2/drv/pnl_cust/Kconfig"
#source "drivers/mstar/drv/software_ir/Kconfig"
source "drivers/mstar2/drv/nand/Kconfig"
#source "drivers/mstar/drv/spinand/Kconfig"
source "drivers/mstar2/drv/ufs/Kconfig"
source "drivers/mstar2/drv/flash/Kconfig"
source "drivers/mstar2/drv/mbx/Kconfig"
source "drivers/mstar2/drv/fusion/Kconfig"
source "drivers/mstar2/drv/fusion_8_10/Kconfig"
source "drivers/mstar2/drv/fusion_9_03/Kconfig"
source "drivers/mstar2/drv/fusion_mtk/Kconfig"
#source "drivers/mstar/drv/firmware/Kconfig"
#source "drivers/mstar/drv/onenand/Kconfig"
source "drivers/mstar2/drv/gflip/Kconfig"
source "drivers/mstar2/drv/graphic/Kconfig"
source "drivers/mstar2/drv/xc/Kconfig"
source "drivers/mstar2/drv/dolby/Kconfig"
source "drivers/mstar2/drv/tch/Kconfig"
source "drivers/mstar2/drv/hdr10plus_ref/Kconfig"
source "drivers/mstar2/drv/hdmitx4vx1/Kconfig"
#source "drivers/mstar/drv/rfid/Kconfig"
#source "drivers/mstar/drv/vid_pre_alloc_mem/Kconfig"
#source "drivers/mstar/drv/msglog/Kconfig"
#source "drivers/mstar/drv/msgio/Kconfig"
#source "drivers/mstar/drv/tsp/Kconfig"
#source "drivers/mstar/drv/shire/Kconfig"
#source "drivers/mstar/drv/sc/Kconfig"
#source "drivers/mstar/drv/mpif/Kconfig"
source "drivers/mstar2/drv/alsa_audio_driver/Kconfig"
source "drivers/mstar2/drv/dmic/Kconfig"
source "drivers/mstar2/drv/voice/Kconfig"
#source "drivers/mstar/drv/uarttp/Kconfig"
source "drivers/mstar2/drv/semutex/Kconfig"
source "drivers/mstar2/drv/tee_shm/Kconfig"
source "drivers/mstar2/drv/gmac/Kconfig"
source "drivers/mstar2/drv/sc/Kconfig"
#source "drivers/mstar/drv/trustzone/Kconfig"
#source "drivers/mstar/drv/mstar_fb/Kconfig"
source "drivers/mstar2/drv/xzram/Kconfig"
source "drivers/mstar2/drv/sata_host/Kconfig"
source "drivers/mstar2/drv/ramlog/Kconfig"
if MSTAR_KANO || MSTAR_MANHATTAN || MSTAR_MONET
source "drivers/mstar2/drv/sdmmc/Kconfig"
endif
if !(MSTAR_KANO || MSTAR_MANHATTAN || MSTAR_MONET)
source "drivers/mstar2/drv/fcie/Kconfig"
source "drivers/mstar2/drv/sdio/Kconfig"
endif
source "drivers/mstar2/drv/cma_pool/Kconfig"
#ifdef CONFIG_MP_MMA_ENABLE
source "drivers/mstar2/drv/miu_protect/Kconfig"
source "drivers/mstar2/drv/mma/Kconfig"
#endif
#source "drivers/mstar/drv/emac2/Kconfig"
#source "drivers/mstar/drv/pm_addr/Kconfig"
#source "drivers/mstar/drv/CPU_setting/Kconfig"
#source "drivers/mstar/drv/CPU_calibrating/Kconfig"
source "drivers/mstar2/drv/zdec/Kconfig"
source "drivers/mstar2/drv/dvfs/Kconfig"
source "drivers/mstar2/drv/CPU_calibrating/Kconfig"
source "drivers/mstar2/drv/cpufreq/Kconfig"
source "drivers/mstar2/drv/regulator/Kconfig"
source "drivers/mstar2/drv/thermal/Kconfig"
source "drivers/mstar2/drv/miu/Kconfig"
source "drivers/mstar2/drv/bw/Kconfig"
source "drivers/mstar2/drv/ipanic/Kconfig"
source "drivers/mstar2/drv/env_handler/Kconfig"
source "drivers/mstar2/drv/utopia2k_str/Kconfig"
source "drivers/mstar2/drv/utopia2k_builtin/Kconfig"
source "drivers/mstar2/drv/pm/Kconfig"
source "drivers/mstar2/drv/r2/Kconfig"
source "drivers/mstar2/drv/clkm/Kconfig"
source "drivers/mstar2/drv/pcie/Kconfig"
source "drivers/mstar2/drv/pcie2/Kconfig"
source "drivers/mstar2/drv/dfc/Kconfig"
source "drivers/mstar2/drv/sem/Kconfig"
source "drivers/mstar2/drv/optee_linuxdriver/Kconfig"
endif
source "drivers/mstar2/drv/noe/Kconfig"
source "drivers/mstar2/drv/util/Kconfig"
source "drivers/mstar2/drv/monitor/Kconfig"
source "drivers/mstar2/drv/mzc/Kconfig"
source "drivers/mstar2/drv/qos/Kconfig"
source "drivers/mstar2/drv/lp_standby/Kconfig"
source "drivers/mstar2/drv/taskstatus/Kconfig"
source "drivers/mstar2/drv/armce_test/Kconfig"
source "drivers/mstar2/drv/leds/Kconfig"
source "drivers/mstar2/drv/wifi_ctl/Kconfig"
endmenu
```
